## conf/layer.conf
```bitbake
# We have a conf and classes directory, add to BBPATH
BBPATH .= ":${LAYERDIR}"

# We have recipes-* directories, add to BBFILES
BBFILES += "${LAYERDIR}/recipes-*/*/*.bb \
            ${LAYERDIR}/recipes-*/*/*.bbappend"

BBFILE_COLLECTIONS += "meta-pen"
BBFILE_PATTERN_meta-pen = "^${LAYERDIR}/"
BBFILE_PRIORITY_meta-pen = "9"

LAYERDEPENDS_meta-pen = "core meta-lmp-base meta-lmp-bsp"
LAYERSERIES_COMPAT_meta-pen = "kirkstone"
```
